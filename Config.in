## Config.in
```kconfig
menuconfig BR2_PACKAGE_GST_AML_PLUGINS1
    bool "gst-aml-plugins1"
    depends on BR2_PACKAGE_GSTREAMER1
    depends on BR2_PACKAGE_LIBPLAYER
    select BR2_PACKAGE_SPEEXDSP
    help
        Amlogic GStreamer1 plugins 1.0 to send audio es to aml dsp and video es to aml hw decoder. decode and render will be complete at kernel level.

if BR2_PACKAGE_GST_AML_PLUGINS1
config BR2_PACKAGE_GST_AML_PLUGINS1_DEFAULT
		bool "gst-aml-plugins1 adec, vdec, amlasin, amlvsink"
		default y
		help
			Amlogic default GStreamer1 plugins 1.0
			amlvdec, amladec, amlasink, amlvsink
endif
```
